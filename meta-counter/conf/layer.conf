## meta-counter/conf/layer.conf
```bitbake
# Шлях до шару для BitBake
BBPATH .= ":${LAYERDIR}"

# Де шукати рецепти цього шару
BBFILES += "${LAYERDIR}/recipes-*/*/*.bb \
            ${LAYERDIR}/recipes-*/*/*.bbappend"

BBFILE_COLLECTIONS += "counter"
BBFILE_PATTERN_counter = "^${LAYERDIR}/"
BBFILE_PRIORITY_counter = "10"

LAYERDEPENDS_counter = "core"
LAYERSERIES_COMPAT_counter = "wrynose"
```
